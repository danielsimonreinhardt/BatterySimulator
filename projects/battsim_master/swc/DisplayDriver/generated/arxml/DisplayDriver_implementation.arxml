AUTOSAR XML (schema 00051)
package /Components/SwcImplementations
  swc implementation DisplayDriver_Impl: programming-language=C, sw-version=1.2.1, used-code-generator=Embedded Coder 24.1 (R2024a) 19-Nov-2023, vendor-id=0, behavior=DisplayDriver_IB
    code-descriptors:
      code Code
        artifact-descriptors:
          short-label=DisplayDriver_c, category=SWSRC
          short-label=DisplayDriver_h, category=SWHDR
          short-label=DisplayDriver_private_h, category=SWHDR
          short-label=DisplayDriver_types_h, category=SWHDR
    resource consumption RsrcCons_DisplayDriver
