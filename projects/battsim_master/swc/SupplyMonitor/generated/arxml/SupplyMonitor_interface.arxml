AUTOSAR XML (schema 00051)
package /Interfaces
  6 x sender receiver interface:
    ISupply_mV
      data ISupply_mV: category=VALUE, sw-calibration-access=READ-ONLY, type=uint32
    ISupplyQlf
      data ISupplyQlf: category=VALUE, sw-calibration-access=READ-ONLY, type=uint8
    Limit
      data Limit: category=VALUE, sw-calibration-access=READ-ONLY, type=boolean
    Overload
      data Overload: category=VALUE, sw-calibration-access=READ-ONLY, type=boolean
    SupplyCurrent_A
      data SupplyCurrent_A: category=VALUE, sw-calibration-access=READ-ONLY, type=float32
    LimitActive
      data LimitActive: category=VALUE, sw-calibration-access=READ-ONLY, type=boolean
  parameter interface CalPrm
    4 x parameter data prototype, all with category=VALUE, sw-calibration-access=READ-WRITE, type=float32:
      SupplyCurrentFilter
      SupplyCurrentGain
      OverloadThd_mA
      OverloadHyst_mA
