AUTOSAR XML (schema 00051)
package /Interfaces
  4 x sender receiver interface:
    ISupply_mV
      data ISupply_mV: category=VALUE, sw-calibration-access=READ-ONLY, type=uint32
    ISupplyQlf
      data ISupplyQlf: category=VALUE, sw-calibration-access=READ-ONLY, type=uint8
    Limit
      data Limit: category=VALUE, sw-calibration-access=READ-ONLY, type=boolean
    Overload
      data Overload: category=VALUE, sw-calibration-access=READ-ONLY, type=boolean
