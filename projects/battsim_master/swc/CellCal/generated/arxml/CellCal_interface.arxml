AUTOSAR XML (schema 00051)
package /Interfaces
  133 x sender receiver interface:
    OutputsOn
      data OutputsOn: category=VALUE, sw-calibration-access=READ-ONLY, type=boolean
    ApplyRequest
      data ApplyRequest: category=VALUE, sw-calibration-access=READ-ONLY, type=uint8
    StSetOffset01
      data StSetOffset01: category=VALUE, sw-calibration-access=READ-ONLY, type=sint16
    StSetOffset02
      data StSetOffset02: category=VALUE, sw-calibration-access=READ-ONLY, type=sint16
    StSetOffset03
      data StSetOffset03: category=VALUE, sw-calibration-access=READ-ONLY, type=sint16
    StSetOffset04
      data StSetOffset04: category=VALUE, sw-calibration-access=READ-ONLY, type=sint16
    StSetOffset05
      data StSetOffset05: category=VALUE, sw-calibration-access=READ-ONLY, type=sint16
    StSetOffset06
      data StSetOffset06: category=VALUE, sw-calibration-access=READ-ONLY, type=sint16
    StSetOffset07
      data StSetOffset07: category=VALUE, sw-calibration-access=READ-ONLY, type=sint16
    StSetOffset08
      data StSetOffset08: category=VALUE, sw-calibration-access=READ-ONLY, type=sint16
    StSetOffset09
      data StSetOffset09: category=VALUE, sw-calibration-access=READ-ONLY, type=sint16
    StSetOffset10
      data StSetOffset10: category=VALUE, sw-calibration-access=READ-ONLY, type=sint16
    StSetOffset11
      data StSetOffset11: category=VALUE, sw-calibration-access=READ-ONLY, type=sint16
    StSetOffset12
      data StSetOffset12: category=VALUE, sw-calibration-access=READ-ONLY, type=sint16
    StSetOffset13
      data StSetOffset13: category=VALUE, sw-calibration-access=READ-ONLY, type=sint16
    StSetOffset14
      data StSetOffset14: category=VALUE, sw-calibration-access=READ-ONLY, type=sint16
    NvSetOffsetIn
      data NvSetOffsetIn: category=ARRAY, sw-calibration-access=READ-ONLY, type=rt_Array_sint16_CellCount
    NvSetOffsetQlf
      data NvSetOffsetQlf: category=VALUE, sw-calibration-access=READ-ONLY, type=uint8
    StSetGain01
      data StSetGain01: category=VALUE, sw-calibration-access=READ-ONLY, type=uint16
    StSetGain02
      data StSetGain02: category=VALUE, sw-calibration-access=READ-ONLY, type=uint16
    StSetGain03
      data StSetGain03: category=VALUE, sw-calibration-access=READ-ONLY, type=uint16
    StSetGain04
      data StSetGain04: category=VALUE, sw-calibration-access=READ-ONLY, type=uint16
    StSetGain05
      data StSetGain05: category=VALUE, sw-calibration-access=READ-ONLY, type=uint16
    StSetGain06
      data StSetGain06: category=VALUE, sw-calibration-access=READ-ONLY, type=uint16
    StSetGain07
      data StSetGain07: category=VALUE, sw-calibration-access=READ-ONLY, type=uint16
    StSetGain08
      data StSetGain08: category=VALUE, sw-calibration-access=READ-ONLY, type=uint16
    StSetGain09
      data StSetGain09: category=VALUE, sw-calibration-access=READ-ONLY, type=uint16
    StSetGain10
      data StSetGain10: category=VALUE, sw-calibration-access=READ-ONLY, type=uint16
    StSetGain11
      data StSetGain11: category=VALUE, sw-calibration-access=READ-ONLY, type=uint16
    StSetGain12
      data StSetGain12: category=VALUE, sw-calibration-access=READ-ONLY, type=uint16
    StSetGain13
      data StSetGain13: category=VALUE, sw-calibration-access=READ-ONLY, type=uint16
    StSetGain14
      data StSetGain14: category=VALUE, sw-calibration-access=READ-ONLY, type=uint16
    NvSetGainIn
      data NvSetGainIn: category=ARRAY, sw-calibration-access=READ-ONLY, type=rt_Array_uint16_CellCount
    NvSetGainQlf
      data NvSetGainQlf: category=VALUE, sw-calibration-access=READ-ONLY, type=uint8
    StMeasOffset01
      data StMeasOffset01: category=VALUE, sw-calibration-access=READ-ONLY, type=sint16
    StMeasOffset02
      data StMeasOffset02: category=VALUE, sw-calibration-access=READ-ONLY, type=sint16
    StMeasOffset03
      data StMeasOffset03: category=VALUE, sw-calibration-access=READ-ONLY, type=sint16
    StMeasOffset04
      data StMeasOffset04: category=VALUE, sw-calibration-access=READ-ONLY, type=sint16
    StMeasOffset05
      data StMeasOffset05: category=VALUE, sw-calibration-access=READ-ONLY, type=sint16
    StMeasOffset06
      data StMeasOffset06: category=VALUE, sw-calibration-access=READ-ONLY, type=sint16
    StMeasOffset07
      data StMeasOffset07: category=VALUE, sw-calibration-access=READ-ONLY, type=sint16
    StMeasOffset08
      data StMeasOffset08: category=VALUE, sw-calibration-access=READ-ONLY, type=sint16
    StMeasOffset09
      data StMeasOffset09: category=VALUE, sw-calibration-access=READ-ONLY, type=sint16
    StMeasOffset10
      data StMeasOffset10: category=VALUE, sw-calibration-access=READ-ONLY, type=sint16
    StMeasOffset11
      data StMeasOffset11: category=VALUE, sw-calibration-access=READ-ONLY, type=sint16
    StMeasOffset12
      data StMeasOffset12: category=VALUE, sw-calibration-access=READ-ONLY, type=sint16
    StMeasOffset13
      data StMeasOffset13: category=VALUE, sw-calibration-access=READ-ONLY, type=sint16
    StMeasOffset14
      data StMeasOffset14: category=VALUE, sw-calibration-access=READ-ONLY, type=sint16
    NvMeasOffsetIn
      data NvMeasOffsetIn: category=ARRAY, sw-calibration-access=READ-ONLY, type=rt_Array_sint16_CellCount
    NvMeasOffsetQlf
      data NvMeasOffsetQlf: category=VALUE, sw-calibration-access=READ-ONLY, type=uint8
    StMeasGain01
      data StMeasGain01: category=VALUE, sw-calibration-access=READ-ONLY, type=uint16
    StMeasGain02
      data StMeasGain02: category=VALUE, sw-calibration-access=READ-ONLY, type=uint16
    StMeasGain03
      data StMeasGain03: category=VALUE, sw-calibration-access=READ-ONLY, type=uint16
    StMeasGain04
      data StMeasGain04: category=VALUE, sw-calibration-access=READ-ONLY, type=uint16
    StMeasGain05
      data StMeasGain05: category=VALUE, sw-calibration-access=READ-ONLY, type=uint16
    StMeasGain06
      data StMeasGain06: category=VALUE, sw-calibration-access=READ-ONLY, type=uint16
    StMeasGain07
      data StMeasGain07: category=VALUE, sw-calibration-access=READ-ONLY, type=uint16
    StMeasGain08
      data StMeasGain08: category=VALUE, sw-calibration-access=READ-ONLY, type=uint16
    StMeasGain09
      data StMeasGain09: category=VALUE, sw-calibration-access=READ-ONLY, type=uint16
    StMeasGain10
      data StMeasGain10: category=VALUE, sw-calibration-access=READ-ONLY, type=uint16
    StMeasGain11
      data StMeasGain11: category=VALUE, sw-calibration-access=READ-ONLY, type=uint16
    StMeasGain12
      data StMeasGain12: category=VALUE, sw-calibration-access=READ-ONLY, type=uint16
    StMeasGain13
      data StMeasGain13: category=VALUE, sw-calibration-access=READ-ONLY, type=uint16
    StMeasGain14
      data StMeasGain14: category=VALUE, sw-calibration-access=READ-ONLY, type=uint16
    NvMeasGainIn
      data NvMeasGainIn: category=ARRAY, sw-calibration-access=READ-ONLY, type=rt_Array_uint16_CellCount
    NvMeasGainQlf
      data NvMeasGainQlf: category=VALUE, sw-calibration-access=READ-ONLY, type=uint8
    NvSetOffsetOut
      data NvSetOffsetOut: category=ARRAY, sw-calibration-access=READ-ONLY, type=rt_Array_sint16_CellCount
    AcSetOffset01
      data AcSetOffset01: category=VALUE, sw-calibration-access=READ-ONLY, type=sint16
    AcSetOffset02
      data AcSetOffset02: category=VALUE, sw-calibration-access=READ-ONLY, type=sint16
    AcSetOffset03
      data AcSetOffset03: category=VALUE, sw-calibration-access=READ-ONLY, type=sint16
    AcSetOffset04
      data AcSetOffset04: category=VALUE, sw-calibration-access=READ-ONLY, type=sint16
    AcSetOffset05
      data AcSetOffset05: category=VALUE, sw-calibration-access=READ-ONLY, type=sint16
    AcSetOffset06
      data AcSetOffset06: category=VALUE, sw-calibration-access=READ-ONLY, type=sint16
    AcSetOffset07
      data AcSetOffset07: category=VALUE, sw-calibration-access=READ-ONLY, type=sint16
    AcSetOffset08
      data AcSetOffset08: category=VALUE, sw-calibration-access=READ-ONLY, type=sint16
    AcSetOffset09
      data AcSetOffset09: category=VALUE, sw-calibration-access=READ-ONLY, type=sint16
    AcSetOffset10
      data AcSetOffset10: category=VALUE, sw-calibration-access=READ-ONLY, type=sint16
    AcSetOffset11
      data AcSetOffset11: category=VALUE, sw-calibration-access=READ-ONLY, type=sint16
    AcSetOffset12
      data AcSetOffset12: category=VALUE, sw-calibration-access=READ-ONLY, type=sint16
    AcSetOffset13
      data AcSetOffset13: category=VALUE, sw-calibration-access=READ-ONLY, type=sint16
    AcSetOffset14
      data AcSetOffset14: category=VALUE, sw-calibration-access=READ-ONLY, type=sint16
    CalSetOffset_V
      data CalSetOffset_V: category=ARRAY, sw-calibration-access=READ-ONLY, type=rt_Array_float32_CellCount
    NvSetGainOut
      data NvSetGainOut: category=ARRAY, sw-calibration-access=READ-ONLY, type=rt_Array_uint16_CellCount
    AcSetGain01
      data AcSetGain01: category=VALUE, sw-calibration-access=READ-ONLY, type=uint16
    AcSetGain02
      data AcSetGain02: category=VALUE, sw-calibration-access=READ-ONLY, type=uint16
    AcSetGain03
      data AcSetGain03: category=VALUE, sw-calibration-access=READ-ONLY, type=uint16
    AcSetGain04
      data AcSetGain04: category=VALUE, sw-calibration-access=READ-ONLY, type=uint16
    AcSetGain05
      data AcSetGain05: category=VALUE, sw-calibration-access=READ-ONLY, type=uint16
    AcSetGain06
      data AcSetGain06: category=VALUE, sw-calibration-access=READ-ONLY, type=uint16
    AcSetGain07
      data AcSetGain07: category=VALUE, sw-calibration-access=READ-ONLY, type=uint16
    AcSetGain08
      data AcSetGain08: category=VALUE, sw-calibration-access=READ-ONLY, type=uint16
    AcSetGain09
      data AcSetGain09: category=VALUE, sw-calibration-access=READ-ONLY, type=uint16
    AcSetGain10
      data AcSetGain10: category=VALUE, sw-calibration-access=READ-ONLY, type=uint16
    AcSetGain11
      data AcSetGain11: category=VALUE, sw-calibration-access=READ-ONLY, type=uint16
    AcSetGain12
      data AcSetGain12: category=VALUE, sw-calibration-access=READ-ONLY, type=uint16
    AcSetGain13
      data AcSetGain13: category=VALUE, sw-calibration-access=READ-ONLY, type=uint16
    AcSetGain14
      data AcSetGain14: category=VALUE, sw-calibration-access=READ-ONLY, type=uint16
    CalSetGain
      data CalSetGain: category=ARRAY, sw-calibration-access=READ-ONLY, type=rt_Array_float32_CellCount
    NvMeasOffsetOut
      data NvMeasOffsetOut: category=ARRAY, sw-calibration-access=READ-ONLY, type=rt_Array_sint16_CellCount
    AcMeasOffset01
      data AcMeasOffset01: category=VALUE, sw-calibration-access=READ-ONLY, type=sint16
    AcMeasOffset02
      data AcMeasOffset02: category=VALUE, sw-calibration-access=READ-ONLY, type=sint16
    AcMeasOffset03
      data AcMeasOffset03: category=VALUE, sw-calibration-access=READ-ONLY, type=sint16
    AcMeasOffset04
      data AcMeasOffset04: category=VALUE, sw-calibration-access=READ-ONLY, type=sint16
    AcMeasOffset05
      data AcMeasOffset05: category=VALUE, sw-calibration-access=READ-ONLY, type=sint16
    AcMeasOffset06
      data AcMeasOffset06: category=VALUE, sw-calibration-access=READ-ONLY, type=sint16
    AcMeasOffset07
      data AcMeasOffset07: category=VALUE, sw-calibration-access=READ-ONLY, type=sint16
    AcMeasOffset08
      data AcMeasOffset08: category=VALUE, sw-calibration-access=READ-ONLY, type=sint16
    AcMeasOffset09
      data AcMeasOffset09: category=VALUE, sw-calibration-access=READ-ONLY, type=sint16
    AcMeasOffset10
      data AcMeasOffset10: category=VALUE, sw-calibration-access=READ-ONLY, type=sint16
    AcMeasOffset11
      data AcMeasOffset11: category=VALUE, sw-calibration-access=READ-ONLY, type=sint16
    AcMeasOffset12
      data AcMeasOffset12: category=VALUE, sw-calibration-access=READ-ONLY, type=sint16
    AcMeasOffset13
      data AcMeasOffset13: category=VALUE, sw-calibration-access=READ-ONLY, type=sint16
    AcMeasOffset14
      data AcMeasOffset14: category=VALUE, sw-calibration-access=READ-ONLY, type=sint16
    CalMeasOffset_V
      data CalMeasOffset_V: category=ARRAY, sw-calibration-access=READ-ONLY, type=rt_Array_float32_CellCount
    NvMeasGainOut
      data NvMeasGainOut: category=ARRAY, sw-calibration-access=READ-ONLY, type=rt_Array_uint16_CellCount
    AcMeasGain01
      data AcMeasGain01: category=VALUE, sw-calibration-access=READ-ONLY, type=uint16
    AcMeasGain02
      data AcMeasGain02: category=VALUE, sw-calibration-access=READ-ONLY, type=uint16
    AcMeasGain03
      data AcMeasGain03: category=VALUE, sw-calibration-access=READ-ONLY, type=uint16
    AcMeasGain04
      data AcMeasGain04: category=VALUE, sw-calibration-access=READ-ONLY, type=uint16
    AcMeasGain05
      data AcMeasGain05: category=VALUE, sw-calibration-access=READ-ONLY, type=uint16
    AcMeasGain06
      data AcMeasGain06: category=VALUE, sw-calibration-access=READ-ONLY, type=uint16
    AcMeasGain07
      data AcMeasGain07: category=VALUE, sw-calibration-access=READ-ONLY, type=uint16
    AcMeasGain08
      data AcMeasGain08: category=VALUE, sw-calibration-access=READ-ONLY, type=uint16
    AcMeasGain09
      data AcMeasGain09: category=VALUE, sw-calibration-access=READ-ONLY, type=uint16
    AcMeasGain10
      data AcMeasGain10: category=VALUE, sw-calibration-access=READ-ONLY, type=uint16
    AcMeasGain11
      data AcMeasGain11: category=VALUE, sw-calibration-access=READ-ONLY, type=uint16
    AcMeasGain12
      data AcMeasGain12: category=VALUE, sw-calibration-access=READ-ONLY, type=uint16
    AcMeasGain13
      data AcMeasGain13: category=VALUE, sw-calibration-access=READ-ONLY, type=uint16
    AcMeasGain14
      data AcMeasGain14: category=VALUE, sw-calibration-access=READ-ONLY, type=uint16
    CalMeasGain
      data CalMeasGain: category=ARRAY, sw-calibration-access=READ-ONLY, type=rt_Array_float32_CellCount
    ApplyResult
      data ApplyResult: category=VALUE, sw-calibration-access=READ-ONLY, type=uint8
    ApplyBadChannel
      data ApplyBadChannel: category=VALUE, sw-calibration-access=READ-ONLY, type=uint8
    CalState
      data CalState: category=VALUE, sw-calibration-access=READ-ONLY, type=uint8
  parameter interface CalPrm
    parameter data prototype OffsetLimit_code: category=VALUE, sw-calibration-access=READ-WRITE, type=uint16
    parameter data prototype GainMin_code: category=VALUE, sw-calibration-access=READ-WRITE, type=uint16
    parameter data prototype GainMax_code: category=VALUE, sw-calibration-access=READ-WRITE, type=uint16
