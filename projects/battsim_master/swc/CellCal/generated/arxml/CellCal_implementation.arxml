AUTOSAR XML (schema 00051)
package /Components/SwcImplementations
  swc implementation CellCal_Impl: programming-language=C, sw-version=1.2.1, used-code-generator=Embedded Coder 24.1 (R2024a) 19-Nov-2023, vendor-id=0, behavior=CellCal_IB
    code-descriptors:
      code Code
        artifact-descriptors:
          short-label=CellCal_c, category=SWSRC
          short-label=CellCal_h, category=SWHDR
          short-label=CellCal_private_h, category=SWHDR
          short-label=CellCal_types_h, category=SWHDR
    resource consumption RsrcCons_CellCal
