AUTOSAR XML (schema 00051)
package /Components/SwcImplementations
  swc implementation CellChannels_Impl: programming-language=C, sw-version=1.2.1, used-code-generator=Embedded Coder 24.1 (R2024a) 19-Nov-2023, vendor-id=0, behavior=CellChannels_IB
    code-descriptors:
      code Code
        artifact-descriptors:
          short-label=CellChannels_c, category=SWSRC
          short-label=CellChannels_data_c, category=SWSRC
          short-label=CellChannels_h, category=SWHDR
          short-label=CellChannels_private_h, category=SWHDR
          short-label=CellChannels_types_h, category=SWHDR
    resource consumption RsrcCons_CellChannels
