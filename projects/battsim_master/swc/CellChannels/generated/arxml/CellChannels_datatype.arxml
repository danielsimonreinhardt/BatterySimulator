AUTOSAR XML (schema 00051)
standard types defined: boolean, float32, uint8, uint32, uint16
package /DataTypes
  impl type rt_Array_float32_6: category=ARRAY
    element rt_Array_float32_6: array-size=6, array-size-semantics=FIXED-SIZE, implementation-data-type=float32
package /DataTypes/CompuMethods
  compu method COMPU_boolean: 0=FALSE, 1=TRUE
package /DataTypes/SwAddrMethods
  sw addr method CODE: section-type=CODE
  sw addr method CONST: section-type=CONST
  sw addr method VAR: section-type=VAR
package /DataTypes/Units
  unit NoUnit: factor-si-to-unit=1, offset-si-to-unit=0
