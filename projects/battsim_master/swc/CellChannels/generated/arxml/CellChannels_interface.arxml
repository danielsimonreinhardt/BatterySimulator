AUTOSAR XML (schema 00051)
package /Interfaces
  146 x sender receiver interface:
    OutputEnable
      data OutputEnable: category=VALUE, sw-calibration-access=READ-ONLY, type=boolean
    Control010203Qlf
      data Control010203Qlf: category=VALUE, sw-calibration-access=READ-ONLY, type=uint8
    Control040506Qlf
      data Control040506Qlf: category=VALUE, sw-calibration-access=READ-ONLY, type=uint8
    Control070809Qlf
      data Control070809Qlf: category=VALUE, sw-calibration-access=READ-ONLY, type=uint8
    Control101112Qlf
      data Control101112Qlf: category=VALUE, sw-calibration-access=READ-ONLY, type=uint8
    Control131415Qlf
      data Control131415Qlf: category=VALUE, sw-calibration-access=READ-ONLY, type=uint8
    Cell01VoltSet_V
      data Cell01VoltSet_V: category=VALUE, sw-calibration-access=READ-ONLY, type=float32
    Cell01Enable
      data Cell01Enable: category=VALUE, sw-calibration-access=READ-ONLY, type=uint8
    St01
      data St01: category=VALUE, sw-calibration-access=READ-ONLY, type=boolean
    UCell01_mV
      data UCell01_mV: category=VALUE, sw-calibration-access=READ-ONLY, type=uint32
    UCell01Qlf
      data UCell01Qlf: category=VALUE, sw-calibration-access=READ-ONLY, type=uint8
    Cell02VoltSet_V
      data Cell02VoltSet_V: category=VALUE, sw-calibration-access=READ-ONLY, type=float32
    Cell02Enable
      data Cell02Enable: category=VALUE, sw-calibration-access=READ-ONLY, type=uint8
    St02
      data St02: category=VALUE, sw-calibration-access=READ-ONLY, type=boolean
    UCell02_mV
      data UCell02_mV: category=VALUE, sw-calibration-access=READ-ONLY, type=uint32
    UCell02Qlf
      data UCell02Qlf: category=VALUE, sw-calibration-access=READ-ONLY, type=uint8
    Cell03VoltSet_V
      data Cell03VoltSet_V: category=VALUE, sw-calibration-access=READ-ONLY, type=float32
    Cell03Enable
      data Cell03Enable: category=VALUE, sw-calibration-access=READ-ONLY, type=uint8
    St03
      data St03: category=VALUE, sw-calibration-access=READ-ONLY, type=boolean
    UCell03_mV
      data UCell03_mV: category=VALUE, sw-calibration-access=READ-ONLY, type=uint32
    UCell03Qlf
      data UCell03Qlf: category=VALUE, sw-calibration-access=READ-ONLY, type=uint8
    Cell04VoltSet_V
      data Cell04VoltSet_V: category=VALUE, sw-calibration-access=READ-ONLY, type=float32
    Cell04Enable
      data Cell04Enable: category=VALUE, sw-calibration-access=READ-ONLY, type=uint8
    St04
      data St04: category=VALUE, sw-calibration-access=READ-ONLY, type=boolean
    UCell04_mV
      data UCell04_mV: category=VALUE, sw-calibration-access=READ-ONLY, type=uint32
    UCell04Qlf
      data UCell04Qlf: category=VALUE, sw-calibration-access=READ-ONLY, type=uint8
    Cell05VoltSet_V
      data Cell05VoltSet_V: category=VALUE, sw-calibration-access=READ-ONLY, type=float32
    Cell05Enable
      data Cell05Enable: category=VALUE, sw-calibration-access=READ-ONLY, type=uint8
    St05
      data St05: category=VALUE, sw-calibration-access=READ-ONLY, type=boolean
    UCell05_mV
      data UCell05_mV: category=VALUE, sw-calibration-access=READ-ONLY, type=uint32
    UCell05Qlf
      data UCell05Qlf: category=VALUE, sw-calibration-access=READ-ONLY, type=uint8
    Cell06VoltSet_V
      data Cell06VoltSet_V: category=VALUE, sw-calibration-access=READ-ONLY, type=float32
    Cell06Enable
      data Cell06Enable: category=VALUE, sw-calibration-access=READ-ONLY, type=uint8
    St06
      data St06: category=VALUE, sw-calibration-access=READ-ONLY, type=boolean
    UCell06_mV
      data UCell06_mV: category=VALUE, sw-calibration-access=READ-ONLY, type=uint32
    UCell06Qlf
      data UCell06Qlf: category=VALUE, sw-calibration-access=READ-ONLY, type=uint8
    Cell07VoltSet_V
      data Cell07VoltSet_V: category=VALUE, sw-calibration-access=READ-ONLY, type=float32
    Cell07Enable
      data Cell07Enable: category=VALUE, sw-calibration-access=READ-ONLY, type=uint8
    St07
      data St07: category=VALUE, sw-calibration-access=READ-ONLY, type=boolean
    UCell07_mV
      data UCell07_mV: category=VALUE, sw-calibration-access=READ-ONLY, type=uint32
    UCell07Qlf
      data UCell07Qlf: category=VALUE, sw-calibration-access=READ-ONLY, type=uint8
    Cell08VoltSet_V
      data Cell08VoltSet_V: category=VALUE, sw-calibration-access=READ-ONLY, type=float32
    Cell08Enable
      data Cell08Enable: category=VALUE, sw-calibration-access=READ-ONLY, type=uint8
    St08
      data St08: category=VALUE, sw-calibration-access=READ-ONLY, type=boolean
    UCell08_mV
      data UCell08_mV: category=VALUE, sw-calibration-access=READ-ONLY, type=uint32
    UCell08Qlf
      data UCell08Qlf: category=VALUE, sw-calibration-access=READ-ONLY, type=uint8
    Cell09VoltSet_V
      data Cell09VoltSet_V: category=VALUE, sw-calibration-access=READ-ONLY, type=float32
    Cell09Enable
      data Cell09Enable: category=VALUE, sw-calibration-access=READ-ONLY, type=uint8
    St09
      data St09: category=VALUE, sw-calibration-access=READ-ONLY, type=boolean
    UCell09_mV
      data UCell09_mV: category=VALUE, sw-calibration-access=READ-ONLY, type=uint32
    UCell09Qlf
      data UCell09Qlf: category=VALUE, sw-calibration-access=READ-ONLY, type=uint8
    Cell10VoltSet_V
      data Cell10VoltSet_V: category=VALUE, sw-calibration-access=READ-ONLY, type=float32
    Cell10Enable
      data Cell10Enable: category=VALUE, sw-calibration-access=READ-ONLY, type=uint8
    St10
      data St10: category=VALUE, sw-calibration-access=READ-ONLY, type=boolean
    UCell10_mV
      data UCell10_mV: category=VALUE, sw-calibration-access=READ-ONLY, type=uint32
    UCell10Qlf
      data UCell10Qlf: category=VALUE, sw-calibration-access=READ-ONLY, type=uint8
    Cell11VoltSet_V
      data Cell11VoltSet_V: category=VALUE, sw-calibration-access=READ-ONLY, type=float32
    Cell11Enable
      data Cell11Enable: category=VALUE, sw-calibration-access=READ-ONLY, type=uint8
    St11
      data St11: category=VALUE, sw-calibration-access=READ-ONLY, type=boolean
    UCell11_mV
      data UCell11_mV: category=VALUE, sw-calibration-access=READ-ONLY, type=uint32
    UCell11Qlf
      data UCell11Qlf: category=VALUE, sw-calibration-access=READ-ONLY, type=uint8
    Cell12VoltSet_V
      data Cell12VoltSet_V: category=VALUE, sw-calibration-access=READ-ONLY, type=float32
    Cell12Enable
      data Cell12Enable: category=VALUE, sw-calibration-access=READ-ONLY, type=uint8
    St12
      data St12: category=VALUE, sw-calibration-access=READ-ONLY, type=boolean
    UCell12_mV
      data UCell12_mV: category=VALUE, sw-calibration-access=READ-ONLY, type=uint32
    UCell12Qlf
      data UCell12Qlf: category=VALUE, sw-calibration-access=READ-ONLY, type=uint8
    Cell13VoltSet_V
      data Cell13VoltSet_V: category=VALUE, sw-calibration-access=READ-ONLY, type=float32
    Cell13Enable
      data Cell13Enable: category=VALUE, sw-calibration-access=READ-ONLY, type=uint8
    St13
      data St13: category=VALUE, sw-calibration-access=READ-ONLY, type=boolean
    UCell13_mV
      data UCell13_mV: category=VALUE, sw-calibration-access=READ-ONLY, type=uint32
    UCell13Qlf
      data UCell13Qlf: category=VALUE, sw-calibration-access=READ-ONLY, type=uint8
    Cell14VoltSet_V
      data Cell14VoltSet_V: category=VALUE, sw-calibration-access=READ-ONLY, type=float32
    Cell14Enable
      data Cell14Enable: category=VALUE, sw-calibration-access=READ-ONLY, type=uint8
    St14
      data St14: category=VALUE, sw-calibration-access=READ-ONLY, type=boolean
    UCell14_mV
      data UCell14_mV: category=VALUE, sw-calibration-access=READ-ONLY, type=uint32
    UCell14Qlf
      data UCell14Qlf: category=VALUE, sw-calibration-access=READ-ONLY, type=uint8
    En01
      data En01: category=VALUE, sw-calibration-access=READ-ONLY, type=boolean
    Sel01
      data Sel01: category=VALUE, sw-calibration-access=READ-ONLY, type=boolean
    Cell01VoltAct_V
      data Cell01VoltAct_V: category=VALUE, sw-calibration-access=READ-ONLY, type=float32
    Cell01State
      data Cell01State: category=VALUE, sw-calibration-access=READ-ONLY, type=uint8
    Duty01_permille
      data Duty01_permille: category=VALUE, sw-calibration-access=READ-ONLY, type=uint16
    En02
      data En02: category=VALUE, sw-calibration-access=READ-ONLY, type=boolean
    Sel02
      data Sel02: category=VALUE, sw-calibration-access=READ-ONLY, type=boolean
    Cell02VoltAct_V
      data Cell02VoltAct_V: category=VALUE, sw-calibration-access=READ-ONLY, type=float32
    Cell02State
      data Cell02State: category=VALUE, sw-calibration-access=READ-ONLY, type=uint8
    Duty02_permille
      data Duty02_permille: category=VALUE, sw-calibration-access=READ-ONLY, type=uint16
    En03
      data En03: category=VALUE, sw-calibration-access=READ-ONLY, type=boolean
    Sel03
      data Sel03: category=VALUE, sw-calibration-access=READ-ONLY, type=boolean
    Cell03VoltAct_V
      data Cell03VoltAct_V: category=VALUE, sw-calibration-access=READ-ONLY, type=float32
    Cell03State
      data Cell03State: category=VALUE, sw-calibration-access=READ-ONLY, type=uint8
    Duty03_permille
      data Duty03_permille: category=VALUE, sw-calibration-access=READ-ONLY, type=uint16
    En04
      data En04: category=VALUE, sw-calibration-access=READ-ONLY, type=boolean
    Sel04
      data Sel04: category=VALUE, sw-calibration-access=READ-ONLY, type=boolean
    Cell04VoltAct_V
      data Cell04VoltAct_V: category=VALUE, sw-calibration-access=READ-ONLY, type=float32
    Cell04State
      data Cell04State: category=VALUE, sw-calibration-access=READ-ONLY, type=uint8
    Duty04_permille
      data Duty04_permille: category=VALUE, sw-calibration-access=READ-ONLY, type=uint16
    En05
      data En05: category=VALUE, sw-calibration-access=READ-ONLY, type=boolean
    Sel05
      data Sel05: category=VALUE, sw-calibration-access=READ-ONLY, type=boolean
    Cell05VoltAct_V
      data Cell05VoltAct_V: category=VALUE, sw-calibration-access=READ-ONLY, type=float32
    Cell05State
      data Cell05State: category=VALUE, sw-calibration-access=READ-ONLY, type=uint8
    Duty05_permille
      data Duty05_permille: category=VALUE, sw-calibration-access=READ-ONLY, type=uint16
    En06
      data En06: category=VALUE, sw-calibration-access=READ-ONLY, type=boolean
    Sel06
      data Sel06: category=VALUE, sw-calibration-access=READ-ONLY, type=boolean
    Cell06VoltAct_V
      data Cell06VoltAct_V: category=VALUE, sw-calibration-access=READ-ONLY, type=float32
    Cell06State
      data Cell06State: category=VALUE, sw-calibration-access=READ-ONLY, type=uint8
    Duty06_permille
      data Duty06_permille: category=VALUE, sw-calibration-access=READ-ONLY, type=uint16
    En07
      data En07: category=VALUE, sw-calibration-access=READ-ONLY, type=boolean
    Sel07
      data Sel07: category=VALUE, sw-calibration-access=READ-ONLY, type=boolean
    Cell07VoltAct_V
      data Cell07VoltAct_V: category=VALUE, sw-calibration-access=READ-ONLY, type=float32
    Cell07State
      data Cell07State: category=VALUE, sw-calibration-access=READ-ONLY, type=uint8
    Duty07_permille
      data Duty07_permille: category=VALUE, sw-calibration-access=READ-ONLY, type=uint16
    En08
      data En08: category=VALUE, sw-calibration-access=READ-ONLY, type=boolean
    Sel08
      data Sel08: category=VALUE, sw-calibration-access=READ-ONLY, type=boolean
    Cell08VoltAct_V
      data Cell08VoltAct_V: category=VALUE, sw-calibration-access=READ-ONLY, type=float32
    Cell08State
      data Cell08State: category=VALUE, sw-calibration-access=READ-ONLY, type=uint8
    Duty08_permille
      data Duty08_permille: category=VALUE, sw-calibration-access=READ-ONLY, type=uint16
    En09
      data En09: category=VALUE, sw-calibration-access=READ-ONLY, type=boolean
    Sel09
      data Sel09: category=VALUE, sw-calibration-access=READ-ONLY, type=boolean
    Cell09VoltAct_V
      data Cell09VoltAct_V: category=VALUE, sw-calibration-access=READ-ONLY, type=float32
    Cell09State
      data Cell09State: category=VALUE, sw-calibration-access=READ-ONLY, type=uint8
    Duty09_permille
      data Duty09_permille: category=VALUE, sw-calibration-access=READ-ONLY, type=uint16
    En10
      data En10: category=VALUE, sw-calibration-access=READ-ONLY, type=boolean
    Sel10
      data Sel10: category=VALUE, sw-calibration-access=READ-ONLY, type=boolean
    Cell10VoltAct_V
      data Cell10VoltAct_V: category=VALUE, sw-calibration-access=READ-ONLY, type=float32
    Cell10State
      data Cell10State: category=VALUE, sw-calibration-access=READ-ONLY, type=uint8
    Duty10_permille
      data Duty10_permille: category=VALUE, sw-calibration-access=READ-ONLY, type=uint16
    En11
      data En11: category=VALUE, sw-calibration-access=READ-ONLY, type=boolean
    Sel11
      data Sel11: category=VALUE, sw-calibration-access=READ-ONLY, type=boolean
    Cell11VoltAct_V
      data Cell11VoltAct_V: category=VALUE, sw-calibration-access=READ-ONLY, type=float32
    Cell11State
      data Cell11State: category=VALUE, sw-calibration-access=READ-ONLY, type=uint8
    Duty11_permille
      data Duty11_permille: category=VALUE, sw-calibration-access=READ-ONLY, type=uint16
    En12
      data En12: category=VALUE, sw-calibration-access=READ-ONLY, type=boolean
    Sel12
      data Sel12: category=VALUE, sw-calibration-access=READ-ONLY, type=boolean
    Cell12VoltAct_V
      data Cell12VoltAct_V: category=VALUE, sw-calibration-access=READ-ONLY, type=float32
    Cell12State
      data Cell12State: category=VALUE, sw-calibration-access=READ-ONLY, type=uint8
    Duty12_permille
      data Duty12_permille: category=VALUE, sw-calibration-access=READ-ONLY, type=uint16
    En13
      data En13: category=VALUE, sw-calibration-access=READ-ONLY, type=boolean
    Sel13
      data Sel13: category=VALUE, sw-calibration-access=READ-ONLY, type=boolean
    Cell13VoltAct_V
      data Cell13VoltAct_V: category=VALUE, sw-calibration-access=READ-ONLY, type=float32
    Cell13State
      data Cell13State: category=VALUE, sw-calibration-access=READ-ONLY, type=uint8
    Duty13_permille
      data Duty13_permille: category=VALUE, sw-calibration-access=READ-ONLY, type=uint16
    En14
      data En14: category=VALUE, sw-calibration-access=READ-ONLY, type=boolean
    Sel14
      data Sel14: category=VALUE, sw-calibration-access=READ-ONLY, type=boolean
    Cell14VoltAct_V
      data Cell14VoltAct_V: category=VALUE, sw-calibration-access=READ-ONLY, type=float32
    Cell14State
      data Cell14State: category=VALUE, sw-calibration-access=READ-ONLY, type=uint8
    Duty14_permille
      data Duty14_permille: category=VALUE, sw-calibration-access=READ-ONLY, type=uint16
