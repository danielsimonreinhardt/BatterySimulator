AUTOSAR XML (schema 00051)
package /Interfaces
  147 x sender receiver interface:
    OutputEnable
      data OutputEnable: category=VALUE, sw-calibration-access=READ-ONLY, type=boolean
    LimitActive
      data LimitActive: category=VALUE, sw-calibration-access=READ-ONLY, type=boolean
    ControllerOffReq
      data ControllerOffReq: category=VALUE, sw-calibration-access=READ-ONLY, type=uint8
    HandActive
      data HandActive: category=VALUE, sw-calibration-access=READ-ONLY, type=boolean
    HandSetpoint_V
      data HandSetpoint_V: category=ARRAY, sw-calibration-access=READ-ONLY, type=rt_Array_float32_CellCount
    HandEnable
      data HandEnable: category=ARRAY, sw-calibration-access=READ-ONLY, type=rt_Array_boolean_CellCount
    SelectedChannel
      data SelectedChannel: category=VALUE, sw-calibration-access=READ-ONLY, type=uint8
    SelectAllMode
      data SelectAllMode: category=VALUE, sw-calibration-access=READ-ONLY, type=boolean
    CalSetOffset_V
      data CalSetOffset_V: category=ARRAY, sw-calibration-access=READ-ONLY, type=rt_Array_float32_CellCount
    CalSetGain
      data CalSetGain: category=ARRAY, sw-calibration-access=READ-ONLY, type=rt_Array_float32_CellCount
    CalMeasOffset_V
      data CalMeasOffset_V: category=ARRAY, sw-calibration-access=READ-ONLY, type=rt_Array_float32_CellCount
    CalMeasGain
      data CalMeasGain: category=ARRAY, sw-calibration-access=READ-ONLY, type=rt_Array_float32_CellCount
    Cell01VoltSet_V
      data Cell01VoltSet_V: category=VALUE, sw-calibration-access=READ-ONLY, type=float32
    Cell01Enable
      data Cell01Enable: category=VALUE, sw-calibration-access=READ-ONLY, type=uint8
    UCell01_mV
      data UCell01_mV: category=VALUE, sw-calibration-access=READ-ONLY, type=uint32
    UCell01Qlf
      data UCell01Qlf: category=VALUE, sw-calibration-access=READ-ONLY, type=uint8
    Cell02VoltSet_V
      data Cell02VoltSet_V: category=VALUE, sw-calibration-access=READ-ONLY, type=float32
    Cell02Enable
      data Cell02Enable: category=VALUE, sw-calibration-access=READ-ONLY, type=uint8
    UCell02_mV
      data UCell02_mV: category=VALUE, sw-calibration-access=READ-ONLY, type=uint32
    UCell02Qlf
      data UCell02Qlf: category=VALUE, sw-calibration-access=READ-ONLY, type=uint8
    Cell03VoltSet_V
      data Cell03VoltSet_V: category=VALUE, sw-calibration-access=READ-ONLY, type=float32
    Cell03Enable
      data Cell03Enable: category=VALUE, sw-calibration-access=READ-ONLY, type=uint8
    UCell03_mV
      data UCell03_mV: category=VALUE, sw-calibration-access=READ-ONLY, type=uint32
    UCell03Qlf
      data UCell03Qlf: category=VALUE, sw-calibration-access=READ-ONLY, type=uint8
    Cell04VoltSet_V
      data Cell04VoltSet_V: category=VALUE, sw-calibration-access=READ-ONLY, type=float32
    Cell04Enable
      data Cell04Enable: category=VALUE, sw-calibration-access=READ-ONLY, type=uint8
    UCell04_mV
      data UCell04_mV: category=VALUE, sw-calibration-access=READ-ONLY, type=uint32
    UCell04Qlf
      data UCell04Qlf: category=VALUE, sw-calibration-access=READ-ONLY, type=uint8
    Cell05VoltSet_V
      data Cell05VoltSet_V: category=VALUE, sw-calibration-access=READ-ONLY, type=float32
    Cell05Enable
      data Cell05Enable: category=VALUE, sw-calibration-access=READ-ONLY, type=uint8
    UCell05_mV
      data UCell05_mV: category=VALUE, sw-calibration-access=READ-ONLY, type=uint32
    UCell05Qlf
      data UCell05Qlf: category=VALUE, sw-calibration-access=READ-ONLY, type=uint8
    Cell06VoltSet_V
      data Cell06VoltSet_V: category=VALUE, sw-calibration-access=READ-ONLY, type=float32
    Cell06Enable
      data Cell06Enable: category=VALUE, sw-calibration-access=READ-ONLY, type=uint8
    UCell06_mV
      data UCell06_mV: category=VALUE, sw-calibration-access=READ-ONLY, type=uint32
    UCell06Qlf
      data UCell06Qlf: category=VALUE, sw-calibration-access=READ-ONLY, type=uint8
    Cell07VoltSet_V
      data Cell07VoltSet_V: category=VALUE, sw-calibration-access=READ-ONLY, type=float32
    Cell07Enable
      data Cell07Enable: category=VALUE, sw-calibration-access=READ-ONLY, type=uint8
    UCell07_mV
      data UCell07_mV: category=VALUE, sw-calibration-access=READ-ONLY, type=uint32
    UCell07Qlf
      data UCell07Qlf: category=VALUE, sw-calibration-access=READ-ONLY, type=uint8
    Cell08VoltSet_V
      data Cell08VoltSet_V: category=VALUE, sw-calibration-access=READ-ONLY, type=float32
    Cell08Enable
      data Cell08Enable: category=VALUE, sw-calibration-access=READ-ONLY, type=uint8
    UCell08_mV
      data UCell08_mV: category=VALUE, sw-calibration-access=READ-ONLY, type=uint32
    UCell08Qlf
      data UCell08Qlf: category=VALUE, sw-calibration-access=READ-ONLY, type=uint8
    Cell09VoltSet_V
      data Cell09VoltSet_V: category=VALUE, sw-calibration-access=READ-ONLY, type=float32
    Cell09Enable
      data Cell09Enable: category=VALUE, sw-calibration-access=READ-ONLY, type=uint8
    UCell09_mV
      data UCell09_mV: category=VALUE, sw-calibration-access=READ-ONLY, type=uint32
    UCell09Qlf
      data UCell09Qlf: category=VALUE, sw-calibration-access=READ-ONLY, type=uint8
    Cell10VoltSet_V
      data Cell10VoltSet_V: category=VALUE, sw-calibration-access=READ-ONLY, type=float32
    Cell10Enable
      data Cell10Enable: category=VALUE, sw-calibration-access=READ-ONLY, type=uint8
    UCell10_mV
      data UCell10_mV: category=VALUE, sw-calibration-access=READ-ONLY, type=uint32
    UCell10Qlf
      data UCell10Qlf: category=VALUE, sw-calibration-access=READ-ONLY, type=uint8
    Cell11VoltSet_V
      data Cell11VoltSet_V: category=VALUE, sw-calibration-access=READ-ONLY, type=float32
    Cell11Enable
      data Cell11Enable: category=VALUE, sw-calibration-access=READ-ONLY, type=uint8
    UCell11_mV
      data UCell11_mV: category=VALUE, sw-calibration-access=READ-ONLY, type=uint32
    UCell11Qlf
      data UCell11Qlf: category=VALUE, sw-calibration-access=READ-ONLY, type=uint8
    Cell12VoltSet_V
      data Cell12VoltSet_V: category=VALUE, sw-calibration-access=READ-ONLY, type=float32
    Cell12Enable
      data Cell12Enable: category=VALUE, sw-calibration-access=READ-ONLY, type=uint8
    UCell12_mV
      data UCell12_mV: category=VALUE, sw-calibration-access=READ-ONLY, type=uint32
    UCell12Qlf
      data UCell12Qlf: category=VALUE, sw-calibration-access=READ-ONLY, type=uint8
    Cell13VoltSet_V
      data Cell13VoltSet_V: category=VALUE, sw-calibration-access=READ-ONLY, type=float32
    Cell13Enable
      data Cell13Enable: category=VALUE, sw-calibration-access=READ-ONLY, type=uint8
    UCell13_mV
      data UCell13_mV: category=VALUE, sw-calibration-access=READ-ONLY, type=uint32
    UCell13Qlf
      data UCell13Qlf: category=VALUE, sw-calibration-access=READ-ONLY, type=uint8
    Cell14VoltSet_V
      data Cell14VoltSet_V: category=VALUE, sw-calibration-access=READ-ONLY, type=float32
    Cell14Enable
      data Cell14Enable: category=VALUE, sw-calibration-access=READ-ONLY, type=uint8
    UCell14_mV
      data UCell14_mV: category=VALUE, sw-calibration-access=READ-ONLY, type=uint32
    UCell14Qlf
      data UCell14Qlf: category=VALUE, sw-calibration-access=READ-ONLY, type=uint8
    En01
      data En01: category=VALUE, sw-calibration-access=READ-ONLY, type=boolean
    Sel01
      data Sel01: category=VALUE, sw-calibration-access=READ-ONLY, type=boolean
    Cell01VoltAct_V
      data Cell01VoltAct_V: category=VALUE, sw-calibration-access=READ-ONLY, type=float32
    Cell01State
      data Cell01State: category=VALUE, sw-calibration-access=READ-ONLY, type=uint8
    Duty01
      data Duty01: category=VALUE, sw-calibration-access=READ-ONLY, type=uint16
    En02
      data En02: category=VALUE, sw-calibration-access=READ-ONLY, type=boolean
    Sel02
      data Sel02: category=VALUE, sw-calibration-access=READ-ONLY, type=boolean
    Cell02VoltAct_V
      data Cell02VoltAct_V: category=VALUE, sw-calibration-access=READ-ONLY, type=float32
    Cell02State
      data Cell02State: category=VALUE, sw-calibration-access=READ-ONLY, type=uint8
    Duty02
      data Duty02: category=VALUE, sw-calibration-access=READ-ONLY, type=uint16
    En03
      data En03: category=VALUE, sw-calibration-access=READ-ONLY, type=boolean
    Sel03
      data Sel03: category=VALUE, sw-calibration-access=READ-ONLY, type=boolean
    Cell03VoltAct_V
      data Cell03VoltAct_V: category=VALUE, sw-calibration-access=READ-ONLY, type=float32
    Cell03State
      data Cell03State: category=VALUE, sw-calibration-access=READ-ONLY, type=uint8
    Duty03
      data Duty03: category=VALUE, sw-calibration-access=READ-ONLY, type=uint16
    En04
      data En04: category=VALUE, sw-calibration-access=READ-ONLY, type=boolean
    Sel04
      data Sel04: category=VALUE, sw-calibration-access=READ-ONLY, type=boolean
    Cell04VoltAct_V
      data Cell04VoltAct_V: category=VALUE, sw-calibration-access=READ-ONLY, type=float32
    Cell04State
      data Cell04State: category=VALUE, sw-calibration-access=READ-ONLY, type=uint8
    Duty04
      data Duty04: category=VALUE, sw-calibration-access=READ-ONLY, type=uint16
    En05
      data En05: category=VALUE, sw-calibration-access=READ-ONLY, type=boolean
    Sel05
      data Sel05: category=VALUE, sw-calibration-access=READ-ONLY, type=boolean
    Cell05VoltAct_V
      data Cell05VoltAct_V: category=VALUE, sw-calibration-access=READ-ONLY, type=float32
    Cell05State
      data Cell05State: category=VALUE, sw-calibration-access=READ-ONLY, type=uint8
    Duty05
      data Duty05: category=VALUE, sw-calibration-access=READ-ONLY, type=uint16
    En06
      data En06: category=VALUE, sw-calibration-access=READ-ONLY, type=boolean
    Sel06
      data Sel06: category=VALUE, sw-calibration-access=READ-ONLY, type=boolean
    Cell06VoltAct_V
      data Cell06VoltAct_V: category=VALUE, sw-calibration-access=READ-ONLY, type=float32
    Cell06State
      data Cell06State: category=VALUE, sw-calibration-access=READ-ONLY, type=uint8
    Duty06
      data Duty06: category=VALUE, sw-calibration-access=READ-ONLY, type=uint16
    En07
      data En07: category=VALUE, sw-calibration-access=READ-ONLY, type=boolean
    Sel07
      data Sel07: category=VALUE, sw-calibration-access=READ-ONLY, type=boolean
    Cell07VoltAct_V
      data Cell07VoltAct_V: category=VALUE, sw-calibration-access=READ-ONLY, type=float32
    Cell07State
      data Cell07State: category=VALUE, sw-calibration-access=READ-ONLY, type=uint8
    Duty07
      data Duty07: category=VALUE, sw-calibration-access=READ-ONLY, type=uint16
    En08
      data En08: category=VALUE, sw-calibration-access=READ-ONLY, type=boolean
    Sel08
      data Sel08: category=VALUE, sw-calibration-access=READ-ONLY, type=boolean
    Cell08VoltAct_V
      data Cell08VoltAct_V: category=VALUE, sw-calibration-access=READ-ONLY, type=float32
    Cell08State
      data Cell08State: category=VALUE, sw-calibration-access=READ-ONLY, type=uint8
    Duty08
      data Duty08: category=VALUE, sw-calibration-access=READ-ONLY, type=uint16
    En09
      data En09: category=VALUE, sw-calibration-access=READ-ONLY, type=boolean
    Sel09
      data Sel09: category=VALUE, sw-calibration-access=READ-ONLY, type=boolean
    Cell09VoltAct_V
      data Cell09VoltAct_V: category=VALUE, sw-calibration-access=READ-ONLY, type=float32
    Cell09State
      data Cell09State: category=VALUE, sw-calibration-access=READ-ONLY, type=uint8
    Duty09
      data Duty09: category=VALUE, sw-calibration-access=READ-ONLY, type=uint16
    En10
      data En10: category=VALUE, sw-calibration-access=READ-ONLY, type=boolean
    Sel10
      data Sel10: category=VALUE, sw-calibration-access=READ-ONLY, type=boolean
    Cell10VoltAct_V
      data Cell10VoltAct_V: category=VALUE, sw-calibration-access=READ-ONLY, type=float32
    Cell10State
      data Cell10State: category=VALUE, sw-calibration-access=READ-ONLY, type=uint8
    Duty10
      data Duty10: category=VALUE, sw-calibration-access=READ-ONLY, type=uint16
    En11
      data En11: category=VALUE, sw-calibration-access=READ-ONLY, type=boolean
    Sel11
      data Sel11: category=VALUE, sw-calibration-access=READ-ONLY, type=boolean
    Cell11VoltAct_V
      data Cell11VoltAct_V: category=VALUE, sw-calibration-access=READ-ONLY, type=float32
    Cell11State
      data Cell11State: category=VALUE, sw-calibration-access=READ-ONLY, type=uint8
    Duty11
      data Duty11: category=VALUE, sw-calibration-access=READ-ONLY, type=uint16
    En12
      data En12: category=VALUE, sw-calibration-access=READ-ONLY, type=boolean
    Sel12
      data Sel12: category=VALUE, sw-calibration-access=READ-ONLY, type=boolean
    Cell12VoltAct_V
      data Cell12VoltAct_V: category=VALUE, sw-calibration-access=READ-ONLY, type=float32
    Cell12State
      data Cell12State: category=VALUE, sw-calibration-access=READ-ONLY, type=uint8
    Duty12
      data Duty12: category=VALUE, sw-calibration-access=READ-ONLY, type=uint16
    En13
      data En13: category=VALUE, sw-calibration-access=READ-ONLY, type=boolean
    Sel13
      data Sel13: category=VALUE, sw-calibration-access=READ-ONLY, type=boolean
    Cell13VoltAct_V
      data Cell13VoltAct_V: category=VALUE, sw-calibration-access=READ-ONLY, type=float32
    Cell13State
      data Cell13State: category=VALUE, sw-calibration-access=READ-ONLY, type=uint8
    Duty13
      data Duty13: category=VALUE, sw-calibration-access=READ-ONLY, type=uint16
    En14
      data En14: category=VALUE, sw-calibration-access=READ-ONLY, type=boolean
    Sel14
      data Sel14: category=VALUE, sw-calibration-access=READ-ONLY, type=boolean
    Cell14VoltAct_V
      data Cell14VoltAct_V: category=VALUE, sw-calibration-access=READ-ONLY, type=float32
    Cell14State
      data Cell14State: category=VALUE, sw-calibration-access=READ-ONLY, type=uint8
    Duty14
      data Duty14: category=VALUE, sw-calibration-access=READ-ONLY, type=uint16
    ActualVolt_V
      data ActualVolt_V: category=ARRAY, sw-calibration-access=READ-ONLY, type=rt_Array_float32_CellCount
    ControllerOn
      data ControllerOn: category=VALUE, sw-calibration-access=READ-ONLY, type=boolean
    ControllerOffAct
      data ControllerOffAct: category=VALUE, sw-calibration-access=READ-ONLY, type=uint8
    ChannelsReleased
      data ChannelsReleased: category=VALUE, sw-calibration-access=READ-ONLY, type=boolean
    OverVoltage
      data OverVoltage: category=VALUE, sw-calibration-access=READ-ONLY, type=boolean
    Cell15State
      data Cell15State: category=VALUE, sw-calibration-access=READ-ONLY, type=uint8
    Cell15VoltAct_V
      data Cell15VoltAct_V: category=VALUE, sw-calibration-access=READ-ONLY, type=float32
    Cell16State
      data Cell16State: category=VALUE, sw-calibration-access=READ-ONLY, type=uint8
    Cell16VoltAct_V
      data Cell16VoltAct_V: category=VALUE, sw-calibration-access=READ-ONLY, type=float32
  parameter interface CalPrm
    14 x parameter data prototype, all with sw-calibration-access=READ-WRITE:
      VoltageSetValue_Ax: category=ARRAY, type=rt_Array_float32_6
      VoltageSetPwm_T: category=ARRAY, type=rt_Array_float32_6
      VoltageSenseMeas_Ax: category=ARRAY, type=rt_Array_float32_6
      VoltageSenseValue_T: category=ARRAY, type=rt_Array_float32_6
      SetpointLimit_V: category=VALUE, type=float32
      OverVoltThd_V: category=VALUE, type=float32
      OverVoltTime_cycles: category=VALUE, type=uint8
      OutputFloor_V: category=VALUE, type=float32
      StepThreshold_V: category=VALUE, type=float32
      StepHold_cycles: category=VALUE, type=uint8
      VoltageSenseFilter: category=VALUE, type=float32
      CtrlKp: category=VALUE, type=float32
      CtrlKi_per_s: category=VALUE, type=float32
      CtrlLimit_V: category=VALUE, type=float32
