AUTOSAR XML (schema 00051)
package /Interfaces
  17 x sender receiver interface:
    RemoteControl
      data RemoteControl: category=VALUE, sw-calibration-access=READ-ONLY, type=uint8
    ModeControl
      data ModeControl: category=VALUE, sw-calibration-access=READ-ONLY, type=uint8
    OutputControl
      data OutputControl: category=VALUE, sw-calibration-access=READ-ONLY, type=uint8
    ControlBattSimQlf
      data ControlBattSimQlf: category=VALUE, sw-calibration-access=READ-ONLY, type=uint8
    BtnAllOnOff
      data BtnAllOnOff: category=VALUE, sw-calibration-access=READ-ONLY, type=boolean
    BtnRemote
      data BtnRemote: category=VALUE, sw-calibration-access=READ-ONLY, type=boolean
    Overload
      data Overload: category=VALUE, sw-calibration-access=READ-ONLY, type=boolean
    BattSimStatus
      data BattSimStatus: category=VALUE, sw-calibration-access=READ-ONLY, type=uint8
    OutputStatus
      data OutputStatus: category=VALUE, sw-calibration-access=READ-ONLY, type=uint8
    LedRemote
      data LedRemote: category=VALUE, sw-calibration-access=READ-ONLY, type=boolean
    OutputEnable
      data OutputEnable: category=VALUE, sw-calibration-access=READ-ONLY, type=boolean
    AliveStatusBattSim
      data AliveStatusBattSim: category=VALUE, sw-calibration-access=READ-ONLY, type=uint8
    AliveStatusCells010203
      data AliveStatusCells010203: category=VALUE, sw-calibration-access=READ-ONLY, type=uint8
    AliveStatusCells040506
      data AliveStatusCells040506: category=VALUE, sw-calibration-access=READ-ONLY, type=uint8
    AliveStatusCells070809
      data AliveStatusCells070809: category=VALUE, sw-calibration-access=READ-ONLY, type=uint8
    AliveStatusCells101112
      data AliveStatusCells101112: category=VALUE, sw-calibration-access=READ-ONLY, type=uint8
    AliveStatusCells131415
      data AliveStatusCells131415: category=VALUE, sw-calibration-access=READ-ONLY, type=uint8
