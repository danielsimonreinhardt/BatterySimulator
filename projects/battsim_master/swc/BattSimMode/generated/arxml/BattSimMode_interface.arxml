AUTOSAR XML (schema 00051)
package /Interfaces
  45 x sender receiver interface:
    RemoteControl
      data RemoteControl: category=VALUE, sw-calibration-access=READ-ONLY, type=uint8
    ModeControl
      data ModeControl: category=VALUE, sw-calibration-access=READ-ONLY, type=uint8
    OutputControl
      data OutputControl: category=VALUE, sw-calibration-access=READ-ONLY, type=uint8
    ControlCell010203Qlf
      data ControlCell010203Qlf: category=VALUE, sw-calibration-access=READ-ONLY, type=uint8
    ControlCell040506Qlf
      data ControlCell040506Qlf: category=VALUE, sw-calibration-access=READ-ONLY, type=uint8
    ControlCell070809Qlf
      data ControlCell070809Qlf: category=VALUE, sw-calibration-access=READ-ONLY, type=uint8
    ControlCell101112Qlf
      data ControlCell101112Qlf: category=VALUE, sw-calibration-access=READ-ONLY, type=uint8
    ControlCell131415Qlf
      data ControlCell131415Qlf: category=VALUE, sw-calibration-access=READ-ONLY, type=uint8
    ControlCell16Qlf
      data ControlCell16Qlf: category=VALUE, sw-calibration-access=READ-ONLY, type=uint8
    ControlBattSimQlf
      data ControlBattSimQlf: category=VALUE, sw-calibration-access=READ-ONLY, type=uint8
    ControlDynCellSim1Qlf
      data ControlDynCellSim1Qlf: category=VALUE, sw-calibration-access=READ-ONLY, type=uint8
    ControlDynCellSim2Qlf
      data ControlDynCellSim2Qlf: category=VALUE, sw-calibration-access=READ-ONLY, type=uint8
    BtnAllOnOff
      data BtnAllOnOff: category=VALUE, sw-calibration-access=READ-ONLY, type=boolean
    BtnRemote
      data BtnRemote: category=VALUE, sw-calibration-access=READ-ONLY, type=boolean
    Overload
      data Overload: category=VALUE, sw-calibration-access=READ-ONLY, type=boolean
    CurrentInvalid
      data CurrentInvalid: category=VALUE, sw-calibration-access=READ-ONLY, type=boolean
    OverVoltage
      data OverVoltage: category=VALUE, sw-calibration-access=READ-ONLY, type=boolean
    ResetWatchdog
      data ResetWatchdog: category=VALUE, sw-calibration-access=READ-ONLY, type=boolean
    ResetQlf
      data ResetQlf: category=VALUE, sw-calibration-access=READ-ONLY, type=uint8
    BattSimStatus
      data BattSimStatus: category=VALUE, sw-calibration-access=READ-ONLY, type=uint8
    OutputStatus
      data OutputStatus: category=VALUE, sw-calibration-access=READ-ONLY, type=uint8
    LedRemote
      data LedRemote: category=VALUE, sw-calibration-access=READ-ONLY, type=boolean
    OutputEnable
      data OutputEnable: category=VALUE, sw-calibration-access=READ-ONLY, type=boolean
    HandActive
      data HandActive: category=VALUE, sw-calibration-access=READ-ONLY, type=boolean
    FailReason
      data FailReason: category=VALUE, sw-calibration-access=READ-ONLY, type=uint8
    AliveStatusBattSim
      data AliveStatusBattSim: category=VALUE, sw-calibration-access=READ-ONLY, type=uint8
    AliveStatusCells010203
      data AliveStatusCells010203: category=VALUE, sw-calibration-access=READ-ONLY, type=uint8
    AliveStatusCells040506
      data AliveStatusCells040506: category=VALUE, sw-calibration-access=READ-ONLY, type=uint8
    AliveStatusCells070809
      data AliveStatusCells070809: category=VALUE, sw-calibration-access=READ-ONLY, type=uint8
    AliveStatusCells101112
      data AliveStatusCells101112: category=VALUE, sw-calibration-access=READ-ONLY, type=uint8
    AliveStatusCells131415
      data AliveStatusCells131415: category=VALUE, sw-calibration-access=READ-ONLY, type=uint8
    AliveStatusCell16
      data AliveStatusCell16: category=VALUE, sw-calibration-access=READ-ONLY, type=uint8
    AliveStatusBattSimExt
      data AliveStatusBattSimExt: category=VALUE, sw-calibration-access=READ-ONLY, type=uint8
    ValidCell010203
      data ValidCell010203: category=VALUE, sw-calibration-access=READ-ONLY, type=boolean
    ValidCell040506
      data ValidCell040506: category=VALUE, sw-calibration-access=READ-ONLY, type=boolean
    ValidCell070809
      data ValidCell070809: category=VALUE, sw-calibration-access=READ-ONLY, type=boolean
    ValidCell101112
      data ValidCell101112: category=VALUE, sw-calibration-access=READ-ONLY, type=boolean
    ValidCell131415
      data ValidCell131415: category=VALUE, sw-calibration-access=READ-ONLY, type=boolean
    ValidCell16
      data ValidCell16: category=VALUE, sw-calibration-access=READ-ONLY, type=boolean
    ValidBattSim
      data ValidBattSim: category=VALUE, sw-calibration-access=READ-ONLY, type=boolean
    ValidDynCellSim1
      data ValidDynCellSim1: category=VALUE, sw-calibration-access=READ-ONLY, type=boolean
    ValidDynCellSim2
      data ValidDynCellSim2: category=VALUE, sw-calibration-access=READ-ONLY, type=boolean
    FwVersionMajor
      data FwVersionMajor: category=VALUE, sw-calibration-access=READ-ONLY, type=uint8
    FwVersionMinor
      data FwVersionMinor: category=VALUE, sw-calibration-access=READ-ONLY, type=uint8
    FwVersionPatch
      data FwVersionPatch: category=VALUE, sw-calibration-access=READ-ONLY, type=uint8
  parameter interface CalPrm
    4 x parameter data prototype, all with category=VALUE, sw-calibration-access=READ-WRITE, type=uint8:
      VersionMajor
      VersionMinor
      VersionPatch
      ButtonDebounce_cycles
