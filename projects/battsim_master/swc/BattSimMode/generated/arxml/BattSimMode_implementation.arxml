AUTOSAR XML (schema 00051)
package /Components/SwcImplementations
  swc implementation BattSimMode_Impl: programming-language=C, sw-version=1.2.1, used-code-generator=Embedded Coder 24.1 (R2024a) 19-Nov-2023, vendor-id=0, behavior=BattSimMode_IB
    code-descriptors:
      code Code
        artifact-descriptors:
          short-label=BattSimMode_c, category=SWSRC
          short-label=BattSimMode_h, category=SWHDR
          short-label=BattSimMode_private_h, category=SWHDR
          short-label=BattSimMode_types_h, category=SWHDR
    resource consumption RsrcCons_BattSimMode
