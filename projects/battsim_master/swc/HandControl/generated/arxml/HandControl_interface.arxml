AUTOSAR XML (schema 00051)
package /Interfaces
  25 x sender receiver interface:
    HandActive
      data HandActive: category=VALUE, sw-calibration-access=READ-ONLY, type=boolean
    EncVoltCount
      data EncVoltCount: category=VALUE, sw-calibration-access=READ-ONLY, type=uint16
    EncVoltButton
      data EncVoltButton: category=VALUE, sw-calibration-access=READ-ONLY, type=boolean
    EncSelCount
      data EncSelCount: category=VALUE, sw-calibration-access=READ-ONLY, type=uint16
    EncSelButton
      data EncSelButton: category=VALUE, sw-calibration-access=READ-ONLY, type=boolean
    CardKey01
      data CardKey01: category=VALUE, sw-calibration-access=READ-ONLY, type=boolean
    CardKey02
      data CardKey02: category=VALUE, sw-calibration-access=READ-ONLY, type=boolean
    CardKey03
      data CardKey03: category=VALUE, sw-calibration-access=READ-ONLY, type=boolean
    CardKey04
      data CardKey04: category=VALUE, sw-calibration-access=READ-ONLY, type=boolean
    CardKey05
      data CardKey05: category=VALUE, sw-calibration-access=READ-ONLY, type=boolean
    CardKey06
      data CardKey06: category=VALUE, sw-calibration-access=READ-ONLY, type=boolean
    CardKey07
      data CardKey07: category=VALUE, sw-calibration-access=READ-ONLY, type=boolean
    CardKey08
      data CardKey08: category=VALUE, sw-calibration-access=READ-ONLY, type=boolean
    CardKey09
      data CardKey09: category=VALUE, sw-calibration-access=READ-ONLY, type=boolean
    CardKey10
      data CardKey10: category=VALUE, sw-calibration-access=READ-ONLY, type=boolean
    CardKey11
      data CardKey11: category=VALUE, sw-calibration-access=READ-ONLY, type=boolean
    CardKey12
      data CardKey12: category=VALUE, sw-calibration-access=READ-ONLY, type=boolean
    CardKey13
      data CardKey13: category=VALUE, sw-calibration-access=READ-ONLY, type=boolean
    CardKey14
      data CardKey14: category=VALUE, sw-calibration-access=READ-ONLY, type=boolean
    ActualVolt_V
      data ActualVolt_V: category=ARRAY, sw-calibration-access=READ-ONLY, type=rt_Array_float32_CellCount
    HandSetpoint_V
      data HandSetpoint_V: category=ARRAY, sw-calibration-access=READ-ONLY, type=rt_Array_float32_CellCount
    HandEnable
      data HandEnable: category=ARRAY, sw-calibration-access=READ-ONLY, type=rt_Array_boolean_CellCount
    SelectedChannel
      data SelectedChannel: category=VALUE, sw-calibration-access=READ-ONLY, type=uint8
    SelectAllMode
      data SelectAllMode: category=VALUE, sw-calibration-access=READ-ONLY, type=boolean
    DisplayValue_mV
      data DisplayValue_mV: category=VALUE, sw-calibration-access=READ-ONLY, type=uint16
  parameter interface CalPrm
    9 x parameter data prototype, all with category=VALUE, sw-calibration-access=READ-WRITE:
      SetpointLimit_V: type=float32
      CoarseStep_mV: type=float32
      FineStep_mV: type=float32
      CountsPerStep: type=uint8
      KeyDebounce_cycles: type=uint8
      HandMinSetpoint_V: type=float32
      DisplayFilter_cycles: type=uint16
      DisplayHyst_mV: type=uint16
      DisplayJump_mV: type=uint16
