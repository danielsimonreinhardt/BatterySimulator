AUTOSAR XML (schema 00051)
package /Interfaces
  8 x sender receiver interface:
    ISupply_mV
      data ISupply_mV: category=VALUE, sw-calibration-access=READ-ONLY, type=uint32
    ISupplyQlf
      data ISupplyQlf: category=VALUE, sw-calibration-access=READ-ONLY, type=uint8
    Limit
      data Limit: category=VALUE, sw-calibration-access=READ-ONLY, type=boolean
    ChannelsReleased
      data ChannelsReleased: category=VALUE, sw-calibration-access=READ-ONLY, type=boolean
    Overload
      data Overload: category=VALUE, sw-calibration-access=READ-ONLY, type=boolean
    SupplyCurrent_A
      data SupplyCurrent_A: category=VALUE, sw-calibration-access=READ-ONLY, type=float32
    LimitActive
      data LimitActive: category=VALUE, sw-calibration-access=READ-ONLY, type=boolean
    CurrentInvalid
      data CurrentInvalid: category=VALUE, sw-calibration-access=READ-ONLY, type=boolean
  parameter interface CalPrm
    7 x parameter data prototype, all with category=VALUE, sw-calibration-access=READ-WRITE:
      SupplyCurrentFilter: type=float32
      SupplyCurrentGain: type=float32
      OverloadThd_mA: type=float32
      OverloadHyst_mA: type=float32
      MinCurrent_mA: type=float32
      MinCurrentTime_cycles: type=uint8
      CurrentInvalid_cycles: type=uint8
