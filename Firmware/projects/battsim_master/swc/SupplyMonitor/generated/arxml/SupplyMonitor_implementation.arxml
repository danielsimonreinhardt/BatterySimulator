AUTOSAR XML (schema 00051)
package /Components/SwcImplementations
  swc implementation SupplyMonitor_Impl: programming-language=C, sw-version=1.2.1, used-code-generator=Embedded Coder 24.1 (R2024a) 19-Nov-2023, vendor-id=0, behavior=SupplyMonitor_IB
    code-descriptors:
      code Code
        artifact-descriptors:
          short-label=SupplyMonitor_c, category=SWSRC
          short-label=SupplyMonitor_h, category=SWHDR
          short-label=SupplyMonitor_private_h, category=SWHDR
          short-label=SupplyMonitor_types_h, category=SWHDR
    resource consumption RsrcCons_SupplyMonitor
