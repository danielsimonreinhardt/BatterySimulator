AUTOSAR XML (schema 00051)
package /Interfaces
  5 x sender receiver interface:
    DisplayValue_mV
      data DisplayValue_mV: category=VALUE, sw-calibration-access=READ-ONLY, type=uint16
    DispTxDone
      data DispTxDone: category=VALUE, sw-calibration-access=READ-ONLY, type=uint8
    DispTxError
      data DispTxError: category=VALUE, sw-calibration-access=READ-ONLY, type=boolean
    DispTxByte
      data DispTxByte: category=VALUE, sw-calibration-access=READ-ONLY, type=uint8
    DispTxRequest
      data DispTxRequest: category=VALUE, sw-calibration-access=READ-ONLY, type=uint8
  parameter interface CalPrm
    parameter data prototype DisplayRefresh_cycles: category=VALUE, sw-calibration-access=READ-WRITE, type=uint16
    parameter data prototype DisplayRetry_cycles: category=VALUE, sw-calibration-access=READ-WRITE, type=uint16
