AUTOSAR XML (schema 00051)
standard types defined: boolean, uint8, sint16, uint16, float32
package /DataTypes
  impl type rt_Array_sint16_CellCount: category=ARRAY
    element rt_Array_sint16_CellCount: array-size=CellCount, array-size-semantics=FIXED-SIZE, implementation-data-type=sint16
  impl type rt_Array_uint16_CellCount: category=ARRAY
    element rt_Array_uint16_CellCount: array-size=CellCount, array-size-semantics=FIXED-SIZE, implementation-data-type=uint16
  impl type rt_Array_float32_CellCount: category=ARRAY
    element rt_Array_float32_CellCount: array-size=CellCount, array-size-semantics=FIXED-SIZE, implementation-data-type=float32
package /DataTypes/CompuMethods
  compu method COMPU_boolean: 0=FALSE, 1=TRUE
package /DataTypes/SwAddrMethods
  sw addr method CODE: section-type=CODE
  sw addr method CONST: section-type=CONST
  sw addr method VAR: section-type=VAR
package /DataTypes/SystemConstants
  sw systemconst CellCount
  sw systemconstant value set SystemConstantValueSet: sw-systemconst-value{sw-systemconst=CellCount, value=14}
package /DataTypes/Units
  unit NoUnit: factor-si-to-unit=1, offset-si-to-unit=0
