AUTOSAR XML (schema 00051)
package /Interfaces
  29 x sender receiver interface:
    OutputEnable
      data OutputEnable: category=VALUE, sw-calibration-access=READ-ONLY, type=boolean
    ApplyRequest
      data ApplyRequest: category=VALUE, sw-calibration-access=READ-ONLY, type=uint8
    StSetOffset
      data StSetOffset: category=ARRAY, sw-calibration-access=READ-ONLY, type=rt_Array_sint16_CellCount
    NvSetOffsetIn
      data NvSetOffsetIn: category=ARRAY, sw-calibration-access=READ-ONLY, type=rt_Array_sint16_CellCount
    NvSetOffsetQlf
      data NvSetOffsetQlf: category=VALUE, sw-calibration-access=READ-ONLY, type=uint8
    StSetGain
      data StSetGain: category=ARRAY, sw-calibration-access=READ-ONLY, type=rt_Array_uint16_CellCount
    NvSetGainIn
      data NvSetGainIn: category=ARRAY, sw-calibration-access=READ-ONLY, type=rt_Array_uint16_CellCount
    NvSetGainQlf
      data NvSetGainQlf: category=VALUE, sw-calibration-access=READ-ONLY, type=uint8
    StMeasOffset
      data StMeasOffset: category=ARRAY, sw-calibration-access=READ-ONLY, type=rt_Array_sint16_CellCount
    NvMeasOffsetIn
      data NvMeasOffsetIn: category=ARRAY, sw-calibration-access=READ-ONLY, type=rt_Array_sint16_CellCount
    NvMeasOffsetQlf
      data NvMeasOffsetQlf: category=VALUE, sw-calibration-access=READ-ONLY, type=uint8
    StMeasGain
      data StMeasGain: category=ARRAY, sw-calibration-access=READ-ONLY, type=rt_Array_uint16_CellCount
    NvMeasGainIn
      data NvMeasGainIn: category=ARRAY, sw-calibration-access=READ-ONLY, type=rt_Array_uint16_CellCount
    NvMeasGainQlf
      data NvMeasGainQlf: category=VALUE, sw-calibration-access=READ-ONLY, type=uint8
    NvSetOffsetOut
      data NvSetOffsetOut: category=ARRAY, sw-calibration-access=READ-ONLY, type=rt_Array_sint16_CellCount
    AcSetOffset
      data AcSetOffset: category=ARRAY, sw-calibration-access=READ-ONLY, type=rt_Array_sint16_CellCount
    CalSetOffset_V
      data CalSetOffset_V: category=ARRAY, sw-calibration-access=READ-ONLY, type=rt_Array_float32_CellCount
    NvSetGainOut
      data NvSetGainOut: category=ARRAY, sw-calibration-access=READ-ONLY, type=rt_Array_uint16_CellCount
    AcSetGain
      data AcSetGain: category=ARRAY, sw-calibration-access=READ-ONLY, type=rt_Array_uint16_CellCount
    CalSetGain
      data CalSetGain: category=ARRAY, sw-calibration-access=READ-ONLY, type=rt_Array_float32_CellCount
    NvMeasOffsetOut
      data NvMeasOffsetOut: category=ARRAY, sw-calibration-access=READ-ONLY, type=rt_Array_sint16_CellCount
    AcMeasOffset
      data AcMeasOffset: category=ARRAY, sw-calibration-access=READ-ONLY, type=rt_Array_sint16_CellCount
    CalMeasOffset_V
      data CalMeasOffset_V: category=ARRAY, sw-calibration-access=READ-ONLY, type=rt_Array_float32_CellCount
    NvMeasGainOut
      data NvMeasGainOut: category=ARRAY, sw-calibration-access=READ-ONLY, type=rt_Array_uint16_CellCount
    AcMeasGain
      data AcMeasGain: category=ARRAY, sw-calibration-access=READ-ONLY, type=rt_Array_uint16_CellCount
    CalMeasGain
      data CalMeasGain: category=ARRAY, sw-calibration-access=READ-ONLY, type=rt_Array_float32_CellCount
    ApplyResult
      data ApplyResult: category=VALUE, sw-calibration-access=READ-ONLY, type=uint8
    ApplyBadChannel
      data ApplyBadChannel: category=VALUE, sw-calibration-access=READ-ONLY, type=uint8
    CalState
      data CalState: category=VALUE, sw-calibration-access=READ-ONLY, type=uint8
  parameter interface CalPrm
    parameter data prototype OffsetLimit_code: category=VALUE, sw-calibration-access=READ-WRITE, type=uint16
    parameter data prototype GainMin_code: category=VALUE, sw-calibration-access=READ-WRITE, type=uint16
    parameter data prototype GainMax_code: category=VALUE, sw-calibration-access=READ-WRITE, type=uint16
